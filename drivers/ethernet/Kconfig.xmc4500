## drivers/ethernet/Kconfig.xmc4500
```kconfig
config ETHERNET_XMC4500
	bool "XMC 4500 Ethernet driver"
	default y
	help
	  This module implements a kernel device driver for  XMC Ethernet driver.
config PTP_CLOCK_XMC4500
	bool "XMC 4500 Ethernet ptp driver"
	default y
	help
	  This module implements a kernel ptp device driver for  XMC Ethernet driver.
```

## dts/bindings/ethernet/infineon,xmc-ethernet.yaml
```yaml
description: XMC Ethernet

compatible: "infineon,xmc-ethernet"

include: ["ethernet.yaml", "ethernet,fixed-link.yaml"]

properties:
    reg:
      required: true
    interrupts:
      required: true
    label:
      required: true
```
